## drivers/block/rnull/Kconfig
```kconfig
# SPDX-License-Identifier: GPL-2.0
#
# Rust null block device driver configuration

config BLK_DEV_RUST_NULL
	tristate "Rust null block driver (Experimental)"
	depends on RUST && CONFIGFS_FS
	help
	  This is the Rust implementation of the null block driver. Like
	  the C version, the driver allows the user to create virutal block
	  devices that can be configured via various configuration options.

	  If unsure, say N.

config BLK_DEV_RUST_NULL_FAULT_INJECTION
	bool "Support fault injection for Rust Null test block driver"
	depends on BLK_DEV_RUST_NULL && FAULT_INJECTION_CONFIGFS
	help
	  Enable fault injection support for the Rust null block driver. This
	  allows injecting errors into block I/O operations for testing error
	  handling paths and verifying system resilience. Fault injection is
	  configured through configfs alongside the null block device settings.

	  If unsure, say N.
```

## drivers/block/rnvme/Kconfig
```kconfig
# SPDX-License-Identifier: GPL-2.0
#
# Rust nvme device driver configuration

config RUST_NVME
	tristate "Rust NVMe PCI driver"
	depends on RUST
```
